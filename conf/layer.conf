## conf/layer.conf
```bitbake
#
# Copyright (C) 2013 Wind River Systems, Inc.
#
BBPATH ?= ""
# We have a conf and classes directory, add to BBPATH
BBPATH := "${LAYERDIR}:${BBPATH}"

# We have a packages directory, add to BBFILES
BBFILES := "${BBFILES} ${LAYERDIR}/recipes-*/*/*.bb \
	${LAYERDIR}/recipes-*/*/*.bbappend \
	${LAYERDIR}/classes/*.bbclass"

BBFILE_COLLECTIONS += "xilinx-zynq"
BBFILE_PATTERN_xilinx-zynq := "^${LAYERDIR}/"
BBFILE_PRIORITY_xilinx-zynq = "7"

# Let the "No recipes available for: pkg.bbappend" be WARNINGS
BB_DANGLINGAPPENDS_WARNONLY ?= "true"

include conf/wr.conf

# This should only be incremented on significant changes that will
# cause compatibility issues with other layers
LAYERVERSION_xilinx-zynq = "1"

LAYERDEPENDS_xilinx-zynq = "wr-kernel normal"
```

## conf/machine/xilinx-zynq.conf
```bitbake
#@TYPE: Machine
#@NAME: xilinx-zynq
#@DESCRIPTION: xilinx-zynq

DEFAULTTUNE ?= "armv7at-neon"
require conf/machine/include/tune-cortexa9.inc

MACHINE_FEATURES += "usbhost jffs2 ext2 screen pci vfat"
#QSPI flash has 64kB erase size
EXTRA_IMAGECMD_jffs2 = "-lnp -e64KiB"

KERNEL_IMAGETYPE = "uImage"

SERIAL_CONSOLE = "115200 ttyPS0"
SERIAL_CONSOLES = "115200 ttyPS0"

PREFERRED_PROVIDER_virtual/xserver = "xserver-xorg"

XSERVER = "xserver-xorg \
           xf86-input-evdev \
           xf86-input-mouse \
           xf86-video-fbdev \
           xf86-input-keyboard"
```
